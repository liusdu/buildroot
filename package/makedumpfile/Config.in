## package/makedumpfile/Config.in
```kconfig
config BR2_PACKAGE_MAKEDUMPFILE
	bool "makedumpfile"
	depends on BR2_i386 || BR2_x86_64 || BR2_arm || BR2_armeb || \
		BR2_mips || BR2_mips64 || BR2_mipsel || BR2_mips64el || \
		BR2_powerpc || BR2_sh4 || BR2_sh4a || BR2_aarch64 || BR2_aarch64_be
        select BR2_PACKAGE_ELFUTILS
	select BR2_PACKAGE_BZIP2
	select BR2_PACKAGE_ZLIB
	select BR2_SHARED_STATIC_LIBS
	help
	  By using the makedumpfile command, it is possible to shorten the dumpfile of kdump.

	  https://sourceforge.net/projects/makedumpfile/
  	  http://lists.infradead.org/pipermail/kexec/
  	  https://lists.linux-foundation.org/pipermail/fastboot/
```
